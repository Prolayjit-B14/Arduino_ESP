#include <WiFi.h>
#include <ESP_Mail_Client.h>
#include <time.h>

// Wi-Fi Credentials
const char* ssid = "Redmi Note 11 Pro+ 5G";
const char* password = "@polu1411P";

// Gmail SMTP Settings
#define SMTP_HOST "smtp.gmail.com"
#define SMTP_PORT 465
#define AUTHOR_EMAIL "prolayjitbiswas14112004@gmail.com"
#define AUTHOR_PASSWORD "lspi lxjl lkcb jajj"

// Recipient List
const char* recipients[][2] = {
  {"Primary Contact", "prolayjitbiswas14112004@gmail.com"},
  {"Family Member", "bubun15072006@gmail.com"},
  {"Friend", "ankanbhowmik11@gmail.com"}
};

SMTPSession smtp;

void setup() {
  Serial.begin(115200);
  connectToWiFi();

  if (!syncTime()) return;

  // Simulate trigger (replace with button/sensor)
  sendSOSAlert();
}

void connectToWiFi() {
  WiFi.begin(ssid, password);
  Serial.print("🔌 Connecting to WiFi");
  while (WiFi.status() != WL_CONNECTED) {
    delay(500);
    Serial.print(".");
  }
  Serial.println("\n✅ WiFi connected.");
}

bool syncTime() {
  configTime(0, 0, "pool.ntp.org", "time.nist.gov");
  Serial.print("⏳ Syncing time");
  time_t now = time(nullptr);
  unsigned long start = millis();

  while (now < 8 * 3600 * 2 && millis() - start < 10000) {
    delay(500);
    Serial.print(".");
    now = time(nullptr);
  }

  if (now < 8 * 3600 * 2) {
    Serial.println("\n❌ Time sync failed.");
    return false;
  }

  Serial.println("\n✅ Time synced: " + String(ctime(&now)));
  return true;
}

void sendSOSAlert() {
  SMTP_Message message;

  // 📍 Simulated GPS Data (use real GPS for live tracking)
  float latitude = 22.5726;
  float longitude = 88.3639;
  String locationURL = "https://www.google.com/maps/search/?api=1&query=" +
                       String(latitude, 6) + "," + String(longitude, 6);

  // 👤 User Info
  String userName = "X";

  // ⏱ Time
  time_t now = time(nullptr);
  String timestamp = String(ctime(&now));
  timestamp.trim();

  // 📧 Email Subject
  message.subject = "[SOS ALERT] Distress Triggered by " + userName + " | " + timestamp;

  // Sender Details
  message.sender.name = "ESP32 SOS Alert System";
  message.sender.email = AUTHOR_EMAIL;
  message.priority = esp_mail_smtp_priority::esp_mail_smtp_priority_high;

  // Add Recipients
  for (int i = 0; i < sizeof(recipients) / sizeof(recipients[0]); i++) {
    message.addRecipient(recipients[i][0], recipients[i][1]);
  }

  // 📄 Email Body
  String body =
    "Hello,\n\n"
    "🚨 An SOS distress alert has been triggered by the Women Safety Device.\n\n"
    "🆘 SOS Alert Information:\n"
    "--------------------------------------------\n"
    "👤 User: " + userName + "\n"
    "📍 Location: Near College Main Gate\n"
    "📅 Date & Time: " + timestamp + "\n\n"
    "📌 Live Location:\n" + locationURL + "\n\n"  // Gmail auto-previews this link
    "Recommended Action:\n"
    "--------------------------------------------\n"
    "⚠️ Please contact the individual immediately.\n"
    "📞 If unresponsive, notify local authorities.\n\n"
    "This is an automated alert generated by the ESP32 SOS Monitoring System.\n\n"
    "Stay Alert. Stay Safe.\n\n"
    "Sincerely,\n"
    "ESP32 SOS System\n"
    "📧 " + String(AUTHOR_EMAIL);

  // Set Message Content
  message.text.content = body;
  message.text.charSet = "utf-8";
  message.text.transfer_encoding = Content_Transfer_Encoding::enc_7bit;

  // Configure SMTP
  ESP_Mail_Session session;
  session.server.host_name = SMTP_HOST;
  session.server.port = SMTP_PORT;
  session.login.email = AUTHOR_EMAIL;
  session.login.password = AUTHOR_PASSWORD;
  session.login.user_domain = "";

  smtp.debug(1);

  // Send Email
  if (!smtp.connect(&session)) {
    Serial.println("❌ SMTP connection failed.");
    return;
  }

  if (!MailClient.sendMail(&smtp, &message, true)) {
    Serial.println("❌ Email send failed.");
    Serial.println("Error: " + smtp.errorReason());
  } else {
    Serial.println("✅ SOS Email sent successfully with map preview!");
  }

  smtp.closeSession();
}

void loop() {
  // Replace this with button or trigger in real device
}
